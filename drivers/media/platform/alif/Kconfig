## drivers/media/platform/alif/Kconfig
```kconfig
# SPDX-License-Identifier: GPL-2.0-only

comment "Alif media platform drivers"

config VIDEO_ALIF_CPI
	tristate "Alif Ensemble Camera Parallel Interface Driver support"
	depends on VIDEO_DEV && OF
	depends on V4L_PLATFORM_DRIVERS
	select V4L2_FWNODE
	select VIDEOBUF2_DMA_CONTIG
	select VIDEOBUF2_VMALLOC
	select VIDEO_V4L2_SUBDEV_API
	help
	  Driver for Alif Ensemble Camera controller. In Ensemble, the CPI
	  controller has two input interfaces - one interface routed out
	  of the SoC through pinmux for parallel cameras, and the other
	  connected to the MIPI CSI controller which in turn had the CSI
	  interface routed out for serial cameras.
```
